## meta-tema2/conf/layer.conf
```bitbake
# We have a conf and classes directory, add to BBPATH
BBPATH .= ":${LAYERDIR}"

# We have recipes-* directories, add to BBFILES
BBFILES += "${LAYERDIR}/recipes-*/*/*.bb \
            ${LAYERDIR}/recipes-*/*/*.bbappend"

BBFILE_COLLECTIONS += "meta-tema2"
BBFILE_PATTERN_meta-tema2 = "^${LAYERDIR}/"
BBFILE_PRIORITY_meta-tema2 = "6"

LAYERDEPENDS_meta-tema2 = "core"
LAYERSERIES_COMPAT_meta-tema2 = "kirkstone"
```
